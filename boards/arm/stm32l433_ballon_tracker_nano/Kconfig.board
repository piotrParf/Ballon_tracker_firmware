## boards/arm/stm32l433_ballon_tracker_nano/Kconfig.board
```kconfig
# STM32L433RC Nucleo board configuration

# Copyright (c) 2021 Matija Tudan
# SPDX-License-Identifier: Apache-2.0

config BOARD_BALOON_TRACKER_L433CC
	bool "Baloon tracker L433CC board"
	depends on SOC_STM32L433XX
```

## boards/arm/stm32l433_ballon_tracker_nano/Kconfig.defconfig
```kconfig
# STM32L433RC Nucleo board configuration

# Copyright (c) 2021 Matija Tudan
# SPDX-License-Identifier: Apache-2.0

if BOARD_BALOON_TRACKER_L433CC

config BOARD
	default "stm32l433ccu_baloon_tracker"

config SPI_STM32_INTERRUPT
	default y
	depends on SPI

endif # BOARD_BALOON_TRACKER_L433CC
```
